## prj.conf
```kconfig
CONFIG_STDOUT_CONSOLE=y
CONFIG_GPIO=y
# enable to use thread names
CONFIG_THREAD_NAME=y
```

## src/main.c
```c
/**
 *	@author		Phu Truong
 *	@email		phutruong@kienminh.net
 *  @skype		ngocphu811
 *	@website	http://kienminh.net
 */

#include "main.h"
#include "board.h"

#define STACK_SIZE 1024
#define PRIORITY 7

K_SEM_DEFINE(sema, 0, 1);

K_THREAD_STACK_DEFINE(led_stack, STACK_SIZE);
static struct k_thread led_data;

static struct gpio_callback button_cb_data;

struct device *led;
struct device *button;

void thread_led(void *p1, void *p2, void *p3);

static void button_callback(const struct device *dev,
				   struct gpio_callback *cb, uint32_t pins)
{
	ARG_UNUSED(pins);
	if (k_sem_take(&sema, K_NO_WAIT) == 0) {
		printk("button pressed!\n");
	}
}

void main(void)
{
	led = init_led();
	if(led == NULL) return;

	button = init_button();
	if(button == NULL) return;

	gpio_init_callback(&button_cb_data, button_callback, BIT(BUTTON_PIN));
	gpio_add_callback(button, &button_cb_data);
	printk("Set up button at %s pin %d\n", BUTTON_LABEL, BUTTON_PIN);

	k_thread_create(&led_data, led_stack,
			STACK_SIZE, thread_led, NULL, NULL, NULL,
			PRIORITY, 0, K_NO_WAIT);

}

void thread_led(void *p1, void *p2, void *p3)
{
	bool value;

	ARG_UNUSED(p1);
	ARG_UNUSED(p2);
	ARG_UNUSED(p3);

	while (1)
	{
		if (k_sem_take(&sema, K_NO_WAIT) == 0) {
			value = gpio_pin_get(led, LED_PIN);
			gpio_pin_set(led, LED_PIN, !value);
			printk("button pressed!\n");
		}
	}
}

/**
 * minicom -D /dev/ttyACM0
 * west build -b stm32l476g_disco semaphore/sema_thread2isr --pristine
 * west flash
 */

/********************** (C) COPYRIGHT http://kienminh.net/ *****END OF FILE****/
```

## src/board.c
```c
/**
 *	@author		Phu Truong
 *	@email		phutruong@kienminh.net
 *  @skype		ngocphu811
 *	@website	http://kienminh.net
 */

#include "board.h"

struct device *init_led(void)
{
	struct device *led;
	int result;

	led = device_get_binding(LED_LABEL);
	if (led == NULL) {
		printk("Didn't find LED device %s\n", LED_LABEL);
		return NULL;
	}

	result = gpio_pin_configure(led, LED_PIN, GPIO_OUTPUT_ACTIVE | LED_FLAGS);
	if (result != 0) {
		printk("Error %d: failed to configure LED device %s pin %d\n",
		       result, LED_LABEL, LED_PIN);
		return NULL;
	}

	printk("Set up LED at %s pin %d\n", LED_LABEL, LED_PIN);

	return led;
}

struct device *init_button(void)
{
	struct device *button;
	int result;

	button = device_get_binding(BUTTON_LABEL);
	if (button == NULL) {
		printk("Error: didn't find %s device\n", BUTTON_LABEL);
		return;
	}

	result = gpio_pin_configure(button, BUTTON_PIN, BUTTON_FLAGS);
	if (result != 0) {
		printk("Error %d: failed to configure %s pin %d\n",
		       result, BUTTON_LABEL, BUTTON_PIN);
		return;
	}

	result = gpio_pin_interrupt_configure(button,
					   BUTTON_PIN,
					   GPIO_INT_EDGE_TO_ACTIVE);
	if (result != 0) {
		printk("Error %d: failed to configure interrupt on %s pin %d\n",
			result, BUTTON_LABEL, BUTTON_PIN);
		return;
	}
	return button;
}

/********************** (C) COPYRIGHT http://kienminh.net/ *****END OF FILE****/
```

## src/board.h
```c
/**
 *	@author		Phu Truong
 *	@email		phutruong@kienminh.net
 *  @skype		ngocphu811
 *	@website	http://kienminh.net
 */

#ifndef __BOARD_H
#define __BOARD_H

#include <device.h>
#include <devicetree.h>
#include <drivers/gpio.h>

#define FLAGS_OR_ZERO(node)						\
	COND_CODE_1(DT_PHA_HAS_CELL(node, gpios, flags),		\
		    (DT_GPIO_FLAGS(node, gpios)),			\
		    (0))

#define LED_NODE		DT_ALIAS(led0)
#define BUTTON_NODE		DT_ALIAS(sw0)

#if DT_NODE_HAS_STATUS(LED_NODE, okay)
	#define LED_LABEL		DT_GPIO_LABEL(LED_NODE, gpios)
	#define LED_PIN			DT_GPIO_PIN(LED_NODE, gpios)
	#define LED_FLAGS		DT_GPIO_FLAGS(LED_NODE, gpios)
#else
	/* A build error here means your board isn't set up to blink an LED. */
	#error "Unsupported board: LED_RED devicetree alias is not defined"
	#define LED_LABEL		""
	#define LED_PIN			0
	#define LED_FLAGS		0
#endif

#if DT_NODE_HAS_STATUS(BUTTON_NODE, okay)
	#define BUTTON_LABEL	DT_GPIO_LABEL(BUTTON_NODE, gpios)
	#define BUTTON_PIN		DT_GPIO_PIN(BUTTON_NODE, gpios)
	#define BUTTON_FLAGS	(GPIO_INPUT | FLAGS_OR_ZERO(BUTTON_NODE))
#else
	#error "Unsupported board: sw0 devicetree alias is not defined"
	#define BUTTON_LABEL	""
	#define BUTTON_PIN		0
	#define BUTTON_FLAGS	0
#endif

struct device *init_led(void);
struct device *init_button(void);

#endif /* __BOARD_H */

/********************** (C) COPYRIGHT http://kienminh.net/ *****END OF FILE****/
```
